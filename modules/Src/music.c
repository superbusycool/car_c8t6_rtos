//
// Created by SuperChen on 2026/6/20.
// 软件PWM版本 — 使用 DWT 微秒延时 + GPIO 直接翻转, 无需 TIM
//

#include "music.h"
#include "main.h"          // BUZZER_Pin, BUZZER_GPIO_Port
#include "dwt.h"           // dwt_delay_us (main.c 已调用 dwt_init)
#include "cmsis_os.h"      // osDelay

/* ───────────────────── 频率表 (MIDI索引 → Hz) ───────────────────── */
static const uint16_t midiFreq_table[] =
        {
                8,
                9,
                9,
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                11840,
                12544
        };

/* ───────────────────── 千与千寻 · 主题曲数据 ───────────────────── */
const midiType Spirited_Away[] =
        {
                0x90,0x59,0x14A0,
                0x80,0x59,0x00D8,
                0x90,0x5B,0x0018,
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                0x80,0x65,0x0360,

        };

const uint16_t SPIRITED_AWAY_LEN = sizeof(Spirited_Away) / sizeof(midiType);

/* ───────────────────── 软件PWM播放 (legato 连奏) ───────────────────── */
/**
 * @brief  在任务中阻塞播放乐曲
 * @param  mid      歌曲数组
 * @param  len      总事件数
 * @param  tick_ms  每个 tick 对应的毫秒数 (推荐 1~2)
 *
 * @note   0x90 = 切换频率 (连续播放, 不中断)
 *         0x80 = 保持当前频率继续播放 (只等时间, 不关声音)
 *         首个事件如果是 0x80 且从未收到过 0x90, 则是前奏静音
 *
 *         原版硬件 PWM 代码中 HAL_TIM_PWM_Stop 误用了 htim3 (电机),
 *         导致蜂鸣器从来不会被关停, 旋律以 legato 方式连续播出.
 *         此处软件实现复刻该行为: 声音持续, 仅在 0x90 时切换频率.
 */
void Music_Play(const midiType *mid, uint16_t len, uint32_t tick_ms)
{
    uint32_t cur_half_us = 0;          /* 0 = 静音; >0 = 当前方波半周期(us) */

    for (uint16_t i = 1; i < len; i++)
    {
        uint32_t dur_ms = (uint32_t)mid[i].tick * tick_ms;

        if (mid[i].onoff == 0x90)
        {
            /* 切换音符 → 更新频率, 声音持续不中断 */
            uint16_t freq = midiFreq_table[mid[i].freq];
            cur_half_us = (freq > 0) ? (500000u / freq) : 0;
        }
        /* else 0x80: 保持当前频率, 继续播放 */

        if (cur_half_us > 0)
        {
            /* ── 软件产生方波, 持续 dur_ms ── */
            uint32_t t_start = HAL_GetTick();
            while ((HAL_GetTick() - t_start) < dur_ms)
            {
                HAL_GPIO_WritePin(BUZZER_GPIO_Port, BUZZER_Pin, GPIO_PIN_SET);
                dwt_delay_us(cur_half_us);
                HAL_GPIO_WritePin(BUZZER_GPIO_Port, BUZZER_Pin, GPIO_PIN_RESET);
                dwt_delay_us(cur_half_us);
            }
        }
        else
        {
            /* ── 静音, 让出 CPU ── */
            HAL_GPIO_WritePin(BUZZER_GPIO_Port, BUZZER_Pin, GPIO_PIN_RESET);
            osDelay(dur_ms);
        }
    }

    /* 播完拉低 */
    HAL_GPIO_WritePin(BUZZER_GPIO_Port, BUZZER_Pin, GPIO_PIN_RESET);
}

/* ───────────────────── 非阻塞音乐状态机 ───────────────────── */
/**
 * 原理：不用 dwt_delay_us 忙等，而是用 dwt_get_time_us() 查询时间戳，
 *       加上 catch-up 算法补偿轮询间隔内的翻转次数，保证平均频率正确。
 *       每次调用立即返回，不阻塞其他任务。
 */
static struct {
    bool            active;
    const midiType *mid;
    uint16_t        len;
    uint16_t        idx;
    uint32_t        tick_ms;
    uint32_t        note_start_tick;   /* HAL_GetTick 音符起始时间 */
    uint32_t        half_us;           /* 半周期 μs, 0=静音 */
    uint64_t        last_toggle_us;    /* DWT 上次翻转时间戳 */
    uint8_t         pin_state;         /* 当前引脚电平 */
} music_nb = {0};

void Music_Play_Start(const midiType *mid, uint16_t len, uint32_t tick_ms)
{
    music_nb.active = true;
    music_nb.mid = mid;
    music_nb.len = len;
    music_nb.tick_ms = tick_ms;
    music_nb.idx = 0;
    music_nb.half_us = 0;
    music_nb.pin_state = 0;
    music_nb.note_start_tick = HAL_GetTick();
    music_nb.last_toggle_us = dwt_get_time_us();
    HAL_GPIO_WritePin(BUZZER_GPIO_Port, BUZZER_Pin, GPIO_PIN_RESET);
}

bool Music_Play_Update(void)
{
    if (!music_nb.active)
        return false;

    const midiType *evt = &music_nb.mid[music_nb.idx];
    uint32_t dur_ms = (uint32_t)evt->tick * music_nb.tick_ms;

    /* 1. 检查当前音符是否播完 */
    if ((HAL_GetTick() - music_nb.note_start_tick) >= dur_ms)
    {
        music_nb.idx++;
        if (music_nb.idx >= music_nb.len)
        {
            music_nb.active = false;
            HAL_GPIO_WritePin(BUZZER_GPIO_Port, BUZZER_Pin, GPIO_PIN_RESET);
            return false;
        }

        evt = &music_nb.mid[music_nb.idx];
        if (evt->onoff == 0x90)
        {
            uint16_t freq = midiFreq_table[evt->freq];
            music_nb.half_us = (freq > 0) ? (500000u / freq) : 0;
        }
        /* 0x80: 保持当前频率不变 */

        music_nb.note_start_tick = HAL_GetTick();
        music_nb.last_toggle_us = dwt_get_time_us();
    }

    /* 2. 非阻塞方波：用 DWT 时间戳 catch-up 计算应翻转次数 */
    if (music_nb.half_us > 0)
    {
        uint64_t now_us = dwt_get_time_us();
        uint64_t elapsed = now_us - music_nb.last_toggle_us;

        if (elapsed >= music_nb.half_us)
        {
            uint32_t toggles = (uint32_t)(elapsed / music_nb.half_us);
            music_nb.last_toggle_us += (uint64_t)toggles * music_nb.half_us;

            if (toggles & 1)                /* 奇数次翻转改变电平 */
                music_nb.pin_state ^= 1;

            HAL_GPIO_WritePin(BUZZER_GPIO_Port, BUZZER_Pin,
                              music_nb.pin_state ? GPIO_PIN_SET : GPIO_PIN_RESET);
        }
    }

    return true;
}

void Music_Play_Stop(void)
{
    music_nb.active = false;
    HAL_GPIO_WritePin(BUZZER_GPIO_Port, BUZZER_Pin, GPIO_PIN_RESET);
}

bool Music_Play_IsPlaying(void)
{
    return music_nb.active;
}
